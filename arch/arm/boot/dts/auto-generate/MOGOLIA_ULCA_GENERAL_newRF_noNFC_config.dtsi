/*
 * Hisilicon Ltd.
 *
 * A15x4 A7x4
 *
 * It is only a demo for hisilicon hi3630 board. You show change the
 * address of each node according to datasheet.
 */


/include/ "MOGOLIA_ULCA_GENERAL_V3_noNFC_config.dtsi"

/ {
	hisi,boardid = <9 3 4 7>;
	hisi,boardname = "MOGOLIA_ULCA_GENERAL_newRF_noNFC";
	hisi,modem_id = <0x3fb09400>;
};
