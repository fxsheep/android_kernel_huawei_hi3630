/*
 * Hisilicon Ltd.
 *
 * A15x4 A7x4
 *
 * It is only a demo for hisilicon hi3630 board. You show change the
 * address of each node according to datasheet.
 */


/include/ "MOGOLIA_ULG_V3_noNFC_config.dtsi"

/ {
	hisi,boardid = <9 2 2 7>;
	hisi,boardname = "MOGOLIA_ULCA_GENERAL_V3_noNFC";
	hisi,modem_id = <0x3fb0e000>;
};
